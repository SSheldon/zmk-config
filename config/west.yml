## config/west.yml
```yaml
manifest:
  remotes:
    - name: zmkfirmware
      url-base: https://github.com/zmkfirmware
    # Additional modules containing boards/shields/custom code can be listed here as well
    # See https://docs.zephyrproject.org/3.2.0/develop/west/manifest.html#projects
    - name: ssheldon
      url-base: https://github.com/SSheldon/
  projects:
    - name: zmk
      remote: ssheldon
      revision: split_wired_reorder
      import: app/west.yml
    - name: zmk-keyboard-chiri-ce
      remote: ssheldon
      revision: main
  self:
    path: config
```
